## sdkconfig.defaults
```kconfig
CONFIG_LV_USE_DEMO_WIDGETS=n
CONFIG_LV_COLOR_DEPTH_16=y
CONFIG_LV_COLOR_16_SWAP=y
CONFIG_LV_MEM_CUSTOM=y
CONFIG_LV_FONT_MONTSERRAT_14=y
CONFIG_LV_FONT_MONTSERRAT_20=y
CONFIG_LV_FONT_MONTSERRAT_28=y
CONFIG_LV_USE_THEME_DEFAULT=y
CONFIG_LV_USE_TEXTAREA=y
CONFIG_LV_USE_QRCODE=y
CONFIG_LV_USE_LABEL=y
CONFIG_LV_USE_BTN=y
CONFIG_LV_USE_LIST=y
CONFIG_LV_USE_ROLLER=y
CONFIG_LV_USE_ANIMIMG=n
CONFIG_LV_FONT_MONTSERRAT_8=y
```
